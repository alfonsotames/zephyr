## boards/arm/itsybitsy_m0/Kconfig.board
```kconfig
# SAM D21 Itsy Bitsy M0 configuration

# Copyright (c) 2018 Bryan O'Donoghue
# SPDX-License-Identifier: Apache-2.0

config BOARD_ITSYBITSY_M0
	bool "Itsy Bitsy M0"
	depends on SOC_PART_NUMBER_SAMD21G18A
```

## boards/arm/itsybitsy_m0/Kconfig.defconfig
```kconfig
# SAM D21 Itsy Bitsy M0 configuration

# Copyright (c) 2018 Bryan O'Donoghue
# SPDX-License-Identifier: Apache-2.0

config BOARD
	default "itsybitsy_M0"
	depends on BOARD_ITSYBITSY_M0
```

## boards/arm/itsybitsy_m0/itsybitsy_m0_defconfig
```kconfig
# Copyright (c) 2018 Bryan O'Donoghue
# SPDX-License-Identifier: Apache-2.0



CONFIG_SOC_SERIES_SAMD21=y
CONFIG_SOC_PART_NUMBER_SAMD21G18A=y
CONFIG_BOARD_ITSYBITSY_M0=y
CONFIG_SOC_ATMEL_SAMD_OSC8M_AS_MAIN=y
CONFIG_CORTEX_M_SYSTICK=y

CONFIG_GPIO=y
CONFIG_GPIO_SAM0=y

CONFIG_PINMUX=y
CONFIG_PINMUX_SAM0=y

CONFIG_WATCHDOG=y
CONFIG_WDT_SAM0=y

CONFIG_SPI=y
CONFIG_SPI_SAM0=y

CONFIG_I2C=y
CONFIG_I2C_SAM0=y

CONFIG_COUNTER=n
CONFIG_COUNTER_SAM0_TC32=n

CONFIG_USB=y
CONFIG_USB_DC_SAM0=y

CONFIG_USB_CDC_ACM=y

CONFIG_CONSOLE=y
CONFIG_UART_CONSOLE=y
CONFIG_SERIAL=y

CONFIG_UART_SAM0=y
CONFIG_UART_INTERRUPT_DRIVEN=y

CONFIG_DMA=n
CONFIG_DMA_SAM0=n


CONFIG_USB_DEVICE_STACK=y
CONFIG_USB_DEVICE_PRODUCT="Serafino M0"
CONFIG_USB_UART_CONSOLE=y


CONFIG_UART_LINE_CTRL=y
CONFIG_UART_CONSOLE_ON_DEV_NAME="CDC_ACM_0"

CONFIG_USB_UART_DTR_WAIT=y
```

## drivers/display/Kconfig.ili9163
```kconfig
# ILI9163 display driver configuration options

# Copyright (c) 2017 Jan Van Winkel <jan.van_winkel@dxplore.eu>
# SPDX-License-Identifier: Apache-2.0

menuconfig ILI9163
	bool "ILI9163 display driver"
	depends on SPI
	help
	  Enable driver for ILI9163 display driver.

if ILI9163

choice
	prompt "LCD"
	default ILI9163_NHD_1_8_128160EF
	help
	  Specify the type of LCD connected to the ILI9163 display controller.

config ILI9163_NHD_1_8_128160EF
	bool "NHD 1.8\" 128160EF"

endchoice

choice
	prompt "Color pixel format"
	help
	  Specify the color pixel format of the ILI9163 display controller.

config ILI9163_RGB888
	bool "RGB888"

config ILI9163_RGB565
	bool "RGB565"

endchoice

endif # ILI9163
```
